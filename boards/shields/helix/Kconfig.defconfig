## boards/shields/helix/Kconfig.defconfig
```kconfig
if SHIELD_HELIX_LEFT

config ZMK_KEYBOARD_NAME
    default "Helix"

config ZMK_SPLIT_ROLE_CENTRAL
    default y

endif

if SHIELD_HELIX_LEFT || SHIELD_HELIX_RIGHT

config ZMK_SPLIT
    default y

config LV_Z_VDB_SIZE
    default 64

config LV_DPI_DEF
    default 148

config LV_Z_BITS_PER_PIXEL
    default 1

endif
```

## boards/shields/helix4/Kconfig.shield
```kconfig
config SHIELD_HELIX4_LEFT
    def_bool $(shields_list_contains,helix4_left)

config SHIELD_HELIX4_RIGHT
    def_bool $(shields_list_contains,helix4_right)
```

## config/dts/bindings/behaviors/zmk,behavior-display-soft-off.yaml
```yaml
description: |
  Display Soft Off behavior. Blanks the display before entering soft off state,
  ensuring OLEDs turn off even when zmk_pm_soft_off() would otherwise suspend
  the I2C bus before the display driver sends its display-off command.

compatible: "zmk,behavior-display-soft-off"

include: zero_param.yaml
```
